## main/Kconfig.projbuild
```kconfig
menu "Example configuration"
    choice EXAMPLE_CHIP_TYPE
        prompt "Select chip type"
        default EXAMPLE_TYPE_AM2301

        config EXAMPLE_TYPE_DHT11
            bool "DHT11"
        config EXAMPLE_TYPE_AM2301
            bool "DHT21/DHT22/AM2301/AM2302/AM2321"
        config EXAMPLE_TYPE_SI7021
            bool "Itead Si7021"
    endchoice

    config EXAMPLE_DATA_GPIO
        int "Data GPIO number"
        default 4 if IDF_TARGET_ESP8266 || IDF_TARGET_ESP32C3
        default 17 if IDF_TARGET_ESP32 || IDF_TARGET_ESP32S2 || IDF_TARGET_ESP32S3
        help
            GPIO number connected to DATA pin

    config EXAMPLE_INTERNAL_PULLUP
        bool "Enable internal pull-up resistor"
        default 0
        help
        	Check this option if you don't have external pull-up resistor on data GPIO.
        	DHT sensors that come mounted on a PCB generally have pull-up resistors on the data pin.
        	But for stable operation, it is recommended to provide an external pull-up resistor.
endmenu

menu "Connection Configuration"

    choice EXAMPLE_CONNECTION_TYPE
        prompt "Connection Type"
        default EXAMPLE_CONNECT_WIFI
        help
            Choose Wi-Fi or ethernet connection.

        config EXAMPLE_CONNECT_WIFI
            bool "Wi-Fi"
            help
                Select internal Ethernet MAC controller.

        config EXAMPLE_CONNECT_ETHERNET
            bool "Ethernet"
            help
                Select external SPI-Ethernet module (DM9051).

    endchoice # EXAMPLE_CONNETION_TYPE


	config WIFI_SSID
		string "WiFi SSID"
		default "OPCUATaskForce"
		help
			Network Name

	config WIFI_PASSWORD
		string "WiFi Password"
		default "OPCUApubsub"
		help
			WiFi Password (WPA or WPA2)

	config USE_STATIC_IP
		bool "Static IP"
		default ""
		help
			Set to use static ip for ethernet connection.

	config ETHERNET_HELPER_STATIC_IP4_ADDRESS
		string "Ip Address"
		default "192.168.1.110"
		help
			Static IP address.

	config ETHERNET_HELPER_STATIC_GATEWAY
		string "Gateway"
		default "192.169.1.1"
		help
			Static gateway address.

	config ETHERNET_HELPER_STATIC_NETMASK
		string "Netmask"
		default "255.255.255.0"
		help
			Netmask
	
	config DNS_ADDRESS
		string "DNS"
		default "8.8.8.8"
		help
			DNS

endmenu

menu "Debug Configuration"

	config UA_LOGLEVEL
		int "Open62541 Server Log Level"
		range 100 600
		default 600
		help
			100 = TRACE
			200 = DEBUG
			300 = INFO
			400 = WARNING
			500 = ERROR
	        600 = FATAL
endmenu
```
